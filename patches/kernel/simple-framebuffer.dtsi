	reserved-memory {
		#address-cells = <1>;
		#size-cells = <1>;
		ranges;

		fb_mem: framebuffer@EC6108_FB_NAME {
			reg = <EC6108_FB_BASE EC6108_FB_SIZE>;
			no-map;
			status = EC6108_FB_STATUS;
		};
__RAMOOPS_CHILD__
	};

	framebuffer@EC6108_FB_NAME {
		compatible = "simple-framebuffer";
		reg = <EC6108_FB_BASE EC6108_FB_SIZE>;
		width = <EC6108_FB_WIDTH>;
		height = <EC6108_FB_HEIGHT>;
		stride = <EC6108_FB_STRIDE>;
		format = "EC6108_FB_FORMAT";
		status = EC6108_FB_STATUS;
	};
